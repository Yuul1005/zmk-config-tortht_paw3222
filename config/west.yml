## config/west.yml
```yaml
manifest:
  remotes:
    - name: zmkfirmware
      url-base: https://github.com/zmkfirmware

    - name: yasio25119915
      url-base: https://github.com/yasio25119915

    - name: cormoran
      url-base: https://github.com/cormoran

  projects:
    # DYA Studio (Custom Studio Protocol) 対応の ZMK fork
    - name: zmk
      remote: cormoran
      revision: main+dya
      clone-depth: 1
      import:
        file: app/west.yml

    # main+dya が使う Zephyr 4.1 (cormoran fork)
    - name: zephyr
      remote: cormoran
      revision: v4.1.0+zmk-fixes+nrf-half-duplex-uart
      clone-depth: 1
      import:
        name-blocklist:
          - ci-tools
          - hal_altera
          - hal_cypress
          - hal_infineon
          - hal_microchip
          - hal_nxp
          - hal_openisa
          - hal_xtensa
          - hal_st
          - hal_ti
          - loramac-node
          - mcuboot
          - mcumgr
          - net-tools
          - openthread
          - edtt
          - trusted-firmware-m

    # トラックボールセンサー
    - name: zmk-driver-paw3222
      remote: yasio25119915
      revision: main

    # --- DYA Studio 用モジュール ---
    # コア
    - name: zmk-feature-custom-settings
      remote: cormoran
      revision: main
    - name: zmk-feature-fast-keymap
      remote: cormoran
      revision: main
    # Keymap タブ: マクロ / コンボ / 押下キー表示 / プレビュー
    - name: zmk-feature-runtime-macro
      remote: cormoran
      revision: main
    - name: zmk-feature-runtime-combo
      remote: cormoran
      revision: main
    - name: zmk-feature-input-stream
      remote: cormoran
      revision: main
    - name: zmk-feature-module-physical-layout
      remote: cormoran
      revision: main
    # Trackball タブ: 感度・回転・オートマウス等
    - name: zmk-module-runtime-input-processor
      remote: cormoran
      revision: main
    # Connection タブ: BLE プロファイル管理
    - name: zmk-module-ble-management
      remote: cormoran
      revision: main
    # Settings タブ: スリープ時間など
    - name: zmk-module-settings-rpc
      remote: cormoran
      revision: main
    # Troubleshooting タブ: デバイス情報
    - name: zmk-feature-device-info
      remote: cormoran
      revision: main

  self:
    path: config
```
